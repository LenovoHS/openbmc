## meta-lenovo/meta-hr650x+/conf/machine/hr650x+.conf
```bitbake
#"Copyright ? 2019-present Lenovo
#Licensed under BSD-3, see COPYING.BSD file for details."


KMACHINE = "aspeed"
#KERNEL_DEVICETREE = "${KMACHINE}-ast2500-evb.dtb"
KERNEL_DEVICETREE = "${KMACHINE}-bmc-lenovo-${MACHINE}.dtb"

UBOOT_MACHINE = "ast_g5_phy_config"

require conf/machine/include/ast2500.inc
require conf/machine/include/obmc-bsp-common.inc
require conf/machine/include/lenovo.inc

FLASH_SIZE = "32768"

#PREFERRED_PROVIDER_virtual/obmc-host-ipmi-hw = "phosphor-ipmi-kcs"
PREFERRED_PROVIDER_virtual/obmc-host-ipmi-hw = "phosphor-ipmi-bt"

#PREFERRED_PROVIDER_virtual/phosphor-led-manager-config-native = "hr650x+-led-manager-config-native"
#PREFERRED_PROVIDER_virtual/phosphor-ipmi-sensor-inventory = "hr650x+-ipmi-sensor-inventory-native"
#PREFERRED_PROVIDER_virtual/phosphor-ipmi-channel-config = "hr650x+-ipmi-channel-config-native"

#PREFERRED_PROVIDER_virtual/phosphor-ipmi-fru-read-inventory = "hr650x+-ipmi-fru-read-inventory-native"
#PREFERRED_PROVIDER_virtual/phosphor-ipmi-fru-inventory = "hr650x+-ipmi-inventory-map-native"
#PREFERRED_PROVIDER_virtual/phosphor-ipmi-fru-properties = "hr650x+-ipmi-fru-properties-native"


PREFERRED_PROVIDER_virtual/obmc-chassis-mgmt = "packagegroup-lenovo-apps"
PREFERRED_PROVIDER_virtual/obmc-fan-mgmt = "packagegroup-lenovo-apps"
PREFERRED_PROVIDER_virtual/obmc-flash-mgmt = "packagegroup-lenovo-apps"
PREFERRED_PROVIDER_virtual/obmc-system-mgmt = "packagegroup-lenovo-apps"
PREFERRED_PROVIDER_virtual/obmc-host-ctl ?= "obmc-op-control-host"
PREFERRED_PROVIDER_virtual/obmc-inventory-data ?= "${VIRTUAL-RUNTIME_skeleton_workbook}"
#PREFERRED_PROVIDER_virtual/obmc-gpio-monitor ?= "phosphor-gpio-monitor"
```
